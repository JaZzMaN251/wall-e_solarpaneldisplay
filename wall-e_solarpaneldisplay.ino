/*
 ***********************************************************************
 * Code by: JaZzMaN251, based on the code of Simon Bluett/Hans Vandamme
 * Date:    11th May 2024
 ***********************************************************************/

/*
   Battery level detection

     .------R1-----.-------R2------.     | The diagram to the left shows the  |
     |             |               |     | potential divider circuit used by  |
   V_Raw     Analogue pin A2      GND    | the battery level detection system |

   @note The scaling factor is theoretically calculated according to ratio of the two resistors:
         DIVIDER_SCALING_FACTOR = R2 / (R1 + R2)
         For example: 47000 / (151000 + 47000) = 0.2374  (resistor values for A0 pin on ESP8266)
         The scaling factor might need adjustment due to the tolerances of the resistors.
         To have a more precise value, measure the output of the potential divider on a full charge.
         Then: Voltage output potential divider / Voltage full battery = DIVIDER_SCALING_FACTOR
*/

#define BATTERY_LEVEL_PIN A0
#define BATTERY_MAX_VOLTAGE 12.6
#define BATTERY_MIN_VOLTAGE 10.8
#define DIVIDER_SCALING_FACTOR 0.2262

#define STATUS_CHECK_TIME 10000   // Time in milliseconds of how often to check robot status (eg. battery level)
unsigned long statusTimer = 0; 

#include <Adafruit_GFX.h>    // Adafruit GFX Library
#include <Adafruit_ST7789.h> // Adafruit_ST7735_and_ST7789_Library
#include <SPI.h>

#define TFT_CS         4
#define TFT_RST        16                                            
#define TFT_DC         5

Adafruit_ST7789 tft = Adafruit_ST7789(TFT_CS, TFT_DC, TFT_RST);

#define YELLOW 0xFFE0
#define RED 0xF800
#define BLACK 0x0000


/**
 * Bitmap saves to PROGMEM
 */

// 'Sun', 61x61px
const unsigned char epd_bitmap_Sun [] PROGMEM = {
  0x00, 0x00, 0x00, 0x07, 0x00, 0x00, 0x00, 0x00, 0x00, 0x00, 0x00, 0x0f, 0x80, 0x00, 0x00, 0x00, 
  0x00, 0x00, 0x00, 0x0f, 0x80, 0x00, 0x00, 0x00, 0x00, 0x00, 0x00, 0x0f, 0x80, 0x00, 0x00, 0x00, 
  0x00, 0x00, 0x00, 0x0f, 0x80, 0x00, 0x00, 0x00, 0x00, 0x01, 0xc0, 0x0f, 0x80, 0x1c, 0x00, 0x00, 
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  0x00, 0x00, 0x00, 0x07, 0x00, 0x00, 0x00, 0x00
};
// 'Solar Charge Level', 195x14px
const unsigned char epd_bitmap_Solar_Charge_Level [] PROGMEM = {
  0x3f, 0x03, 0xf8, 0x60, 0x01, 0xc1, 0xff, 0x00, 0x1f, 0xc6, 0x03, 0x01, 0xc1, 0xff, 0x03, 0xf8, 
  0xff, 0x80, 0xc0, 0x7f, 0xd8, 0x06, 0xff, 0x98, 0x00, 0x7f, 0x87, 0xfc, 0x60, 0x03, 0xc1, 0xff, 
  0x80, 0x3f, 0xe6, 0x03, 0x03, 0xc1, 0xff, 0x87, 0xfc, 0xff, 0x80, 0xc0, 0x7f, 0xdc, 0x0c, 0xff, 
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  0x30, 0x0d, 0x80, 0xc3, 0xf8, 0xff, 0x80, 0xff, 0x7f, 0xc1, 0xe0, 0xff, 0x9f, 0xe0
};
// 'Warning', 112x16px
const unsigned char epd_bitmap_Warning [] PROGMEM = {
  0xf0, 0x3c, 0x1f, 0x1f, 0xc0, 0xff, 0xf0, 0xfe, 0x0f, 0x3c, 0xfe, 0x0f, 0x07, 0xfc, 0xf8, 0x7e, 
  0x1f, 0x1f, 0xe0, 0xff, 0xf8, 0xff, 0x0f, 0x3c, 0xff, 0x0f, 0x0f, 0xfe, 0x78, 0x7e, 0x1e, 0x1f, 
  0xe0, 0xff, 0xfc, 0xff, 0x0f, 0x3c, 0xff, 0x0f, 0x1f, 0xff, 0x78, 0x7e, 0x1e, 0x1f, 0xe0, 0xff, 
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  0x1f, 0xfe, 0x1f, 0xc3, 0xf1, 0xe0, 0x3e, 0xf0, 0x3c, 0xf0, 0x7f, 0x3c, 0xf0, 0x7f, 0x07, 0xfc
};

// Array of all bitmaps for convenience. (Total bytes used to store images in PROGMEM = 1120)
const int epd_bitmap_allArray_LEN = 3;
const unsigned char* epd_bitmap_allArray[3] = {
  epd_bitmap_Solar_Charge_Level,
  epd_bitmap_Sun,
  epd_bitmap_Warning
};


void setup() {

  // Initialize serial communication for debugging
  Serial.begin(115200);
  Serial.println(F("--- Wall-E Solar Panel Sketch ---"));

  // Start up the Display
  Serial.println(F("Starting up the display"));
  tft.init(240, 280);           // Init ST7789 280x240
  tft.fillScreen(ST77XX_BLACK); // Clear the screen
  drawPowerOn(); // Startup sequence
  Serial.println(F("Display started"));

}

/**
 * Battery level detection
 */

void checkBatteryLevel() {

  // Read the analogue pin and calculate battery voltage
  float voltage = analogRead(BATTERY_LEVEL_PIN) * 3.3 / 1024.0;
  voltage = voltage / DIVIDER_SCALING_FACTOR;
  int percentage = int(100 * (voltage - BATTERY_MIN_VOLTAGE) / float(BATTERY_MAX_VOLTAGE - BATTERY_MIN_VOLTAGE));

  // Send the percentage via serial
  Serial.print(F("Battery_")); Serial.println(percentage);

  // Update the Display
  displayLevel(percentage);


}

void loop() {

  // Update robot status
  // -- -- -- -- -- -- -- -- -- -- -- -- -- --
  if (millis() - statusTimer >= STATUS_CHECK_TIME) {
    statusTimer = millis();

    checkBatteryLevel();
  }
}


/**
 * Draw battery level on the display
 */
void displayLevel(int batlevel) {
  
    // Scale to 50% as the battery should not drop bellow that anyway
    
    if (batlevel < 10) drawWarning();
    
    else {
      
    // Delete battery bars
    if (batlevel < 100) delBatt100();
    if (batlevel < 90) delBatt90();
    if (batlevel < 80) delBatt80();
    if (batlevel < 70) delBatt70();
    if (batlevel < 60) delBatt60();
    if (batlevel < 50) delBatt50();
    if (batlevel < 40) delBatt40();
    if (batlevel < 30) delBatt30();
    if (batlevel < 20) delBatt20();

    // Draw battery bars 
    if (batlevel > 10) drawBatt10();
    if (batlevel > 20) drawBatt20();
    if (batlevel > 30) drawBatt30();
    if (batlevel > 40) drawBatt40();
    if (batlevel > 50) drawBatt50();
    if (batlevel > 60) drawBatt60();
    if (batlevel > 70) drawBatt70();
    if (batlevel > 80) drawBatt80();
    if (batlevel > 90) drawBatt90();
    if (batlevel > 99) drawBatt100();
    }
}


/**
 * Functions to draw/delete each of the battery level bars
 */
void drawWarning() {
for (int x = 0; x < 10; x++) { // blink 10 times before checking again
    tft.fillRect( 97,  60,  118,  197,  BLACK);
    tft.fillRect( 97,  231,  118,  26,  RED);
    tft.drawBitmap(100, 236, epd_bitmap_Warning, 112, 16, BLACK);
    delay(588);
    tft.fillRect( 97,  231,  118,  26,  BLACK);
    delay(588);
}
}


/**
 * Delete battery level bars
 */
void delBatt100() {
tft.fillRect( 97,  60,  118,  10,  BLACK);
}

void delBatt90() {
tft.fillRect( 97,  79,  118,  10,  BLACK);
}

void delBatt80() {
tft.fillRect( 97,  98,  118,  10,  BLACK);
}

void delBatt70() {
tft.fillRect( 97,  117,  118,  10,  BLACK);
}

void delBatt60() {
tft.fillRect( 97,  136,  118,  10,  BLACK);
}

void delBatt50() {
tft.fillRect( 97,  155,  118,  10,  BLACK);
}

void delBatt40() {
tft.fillRect( 97,  174,  118,  10,  BLACK);
}

void delBatt30() {
tft.fillRect( 97,  193,  118,  10,  BLACK);
}

void delBatt20() {
tft.fillRect( 97,  212,  118,  10,  BLACK);
}


/**
 * Draw battery level bars
 */
void drawBatt10() {
tft.fillRect( 97,  231,  118,  26,  YELLOW);
}

void drawBatt20() {
tft.fillRect( 97,  212,  118,  10,  YELLOW);
}

void drawBatt30() {
tft.fillRect( 97,  193,  118,  10,  YELLOW);
}

void drawBatt40() {
tft.fillRect( 97,  174,  118,  10,  YELLOW);
}

void drawBatt50() {
  tft.fillRect( 97,  155,  118,  10,  YELLOW);
}

void drawBatt60() {
tft.fillRect( 97,  136,  118,  10,  YELLOW);
}

void drawBatt70() {
tft.fillRect( 97,  117,  118,  10,  YELLOW);
}

void drawBatt80() {
tft.fillRect( 97,  98,  118,  10,  YELLOW);
}

void drawBatt90() {
tft.fillRect( 97,  79,  118,  10,  YELLOW);
}

void drawBatt100() {
tft.fillRect( 97,  60,  118,  10,  YELLOW);
}


/**
 * Draw the sun icon on the display
 */
void drawSun() {
 tft.drawBitmap(18, 56, epd_bitmap_Sun, 61, 61, YELLOW);
}

/**
 * Draw the Solar Charge Level text on the display
 */
void drawTxt() {
 tft.drawBitmap(10, 23, epd_bitmap_Solar_Charge_Level, 195, 14, YELLOW);
}

/**
 * Startup Sequence
 */
void drawPowerOn() {
  tft.drawBitmap(10, 23, epd_bitmap_Solar_Charge_Level, 195, 14, YELLOW);
  tft.drawBitmap(18, 56, epd_bitmap_Sun, 61, 61, YELLOW);
  delay(200);
  tft.fillRect( 97,  231,  118,  26,  YELLOW);
  delay(732);
  tft.fillRect( 97,  212,  118,  10,  YELLOW);
  delay(732);
  tft.fillRect( 97,  193,  118,  10,  YELLOW);
  delay(732);
  tft.fillRect( 97,  174,  118,  10,  YELLOW);
  delay(162);
  tft.fillRect( 97,  155,  118,  10,  YELLOW);
  delay(162);
  tft.fillRect( 97,  136,  118,  10,  YELLOW);
  delay(162);
  tft.fillRect( 97,  117,  118,  10,  YELLOW);
  delay(162);
  tft.fillRect( 97,  98,  118,  10,  YELLOW);
  delay(162);
  tft.fillRect( 97,  79,  118,  10,  YELLOW);
  delay(162);
  tft.fillRect( 97,  60,  118,  10,  YELLOW);
}